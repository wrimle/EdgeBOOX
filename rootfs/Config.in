## rootfs/Config.in
```kconfig
#

mainmenu "Linux Configuration"

config HAVE_DOT_CONFIG
	bool
	default y

menu "Build options"

config TOOLCHAIN_DIR
        string "Toolchain and header file location?"
        default "/opt/freescale/usr/local/gcc-4.1.2-glibc-2.5-nptl-3/arm-none-linux-gnueabi"
        help
            This is the location where the toolchain will be installed.  The
            toolchain will not work if it is moved from this location.
            Therefore, if you wish to package up a uClibc toolchain, it is
            important that is is set to the final location where the toolchain
            will be used.

            Most people will leave this set to the default value.

config DOWNLOAD_SITE
	string "Package download website?"
	default "http://openbooxproject.sourceforge.net/packages"
	help
		This is the web address where you can download the 
		source tarballs needed to build the target system and 
		host programs.

config JLEVEL
        int "Number of jobs to run simultaneously"
        default "1"
        help
            Number of jobs to run simultanesouly
endmenu

source "packages/kernel/Config.in"
source "packages/Config.in"
source "packages/rootfs/Config.in"
```

## rootfs/packages/Config.in
```kconfig
menu "Individual Package Selection for the target"
comment "Basic Root Filesystem"
source "packages/busybox/Config.in"
source "packages/zlib/Config.in"
comment "Other"
source "packages/gdb/Config.in"
comment "Group packages"
menuconfig NETWORK_SUPPORT
        bool "Networking libraries and applications (WLAN/WPA/etc)"
        default y
        help
          Support for networking libraries, wlan-ng, WPA and related
          packages, graphical toolkits, etc.
if NETWORK_SUPPORT
source "packages/wireless_tools/Config.in"
source "packages/wpa_supplicant/Config.in"
source "packages/openssl/Config.in"
endif
menuconfig GRAPHIC_SUPPORT
	bool "Graphic libraries and applications (graphics/text)"
	default y
	help
	  Support for graphic libraries, QT-Embedded/GTK+/DirectFB and related
	  packages, graphical toolkits, etc.
if GRAPHIC_SUPPORT
source "packages/qt/Config.in"
source "packages/onyx/Config.in"
endif
menuconfig HW_SUPPORT
        bool "Hardware handling libraries and applications"
        default y
        help
	  Support for hardware handling and maintenance, block devices,
	  filesystem creation and maintenance.
if HW_SUPPORT
source "packages/udev/Config.in"
source "packages/tslib/Config.in"
source "packages/libusb/Config.in"
source "packages/usbutils/Config.in"
source "packages/usb_modeswitch/Config.in"
source "packages/dosfstools/Config.in"
endif
menuconfig MISCELLANEOUS
	bool "Miscellaneous Software"
	default y
	help
	  This section contains miscellaneous software.
if MISCELLANEOUS
source "packages/sqlite/Config.in"
source "packages/curl/Config.in"
source "packages/expat/Config.in"
source "packages/freetype/Config.in"
source "packages/libiconv/Config.in"
endif
endmenu
```

## rootfs/packages/busybox/Config.in
```kconfig
config PACKAGE_BUSYBOX
	bool "BusyBox"
	default y
	help
	  The Swiss Army Knife of embedded Linux.  It slices, it dices, it
	  makes Julian Fries.

	  http://busybox.net/

	  Most people will answer Y.

config PACKAGE_BUSYBOX_CONFIG
	string "BusyBox configuration file to use?"
	depends PACKAGE_BUSYBOX
	default "packages/busybox/busybox.config"
	help
	  Some people may wish to use their own modified BusyBox configuration
	  file, and will specify their config file location with this option.

	  Most people will just use the default BusyBox configuration file.
```

## rootfs/packages/curl/Config.in
```kconfig
config PACKAGE_CURL
	bool "curl"
	default y
	help
	 curl is a command line tool for transferring files with URL syntax
```

## rootfs/packages/dosfstools/Config.in
```kconfig
config PACKAGE_DOSFS_TOOLS
	bool "DOS Filesystem Tools"
	default y
	help
	  Standard DOS Filesystem tools MKDOSFS/DOSFSCK.
	  Used for HDD Formating and USB Thumb Drives.
```

## rootfs/packages/freetype/Config.in
```kconfig
config PACKAGE_FREETYPE
	bool "freetype"
	default y
	help

	http://www.freetype.org/
```

## rootfs/packages/gdb/Config.in
```kconfig
config PACKAGE_GDB_SERVER
        bool "GDB Server for the Target"
        default n
        help
            Build the gdbserver stub to run on the target.
            A full gdb is needed to debug the progam.

config PACKAGE_GDB_HOST
        bool "GDB for the HOST PC"
        default n
        help
             Build gdb to run on the host to debug programs run on the target.
```

## rootfs/packages/kernel/Config.in
```kconfig
menu "Linux kernel for Freescale MXC/iMX Series"

source "packages/kernel/headers/Config.in"

source "packages/kernel/linux/Config.in"

endmenu
```

## rootfs/packages/kernel/headers/Config.in
```kconfig
choice
        prompt "Kernel Version"
        default KERNEL_VERSION_2_6_26
        help
          Select the version of the Linux Kernel you wish to use.
		
	config KERNEL_VERSION_2_6_26
		bool "linux-2.6.26"

endchoice
config DEFAULT_KERNEL_VERSION
        string
	default "2.6.26"	if KERNEL_VERSION_2_6_26
```

## rootfs/packages/kernel/linux/Config.in
```kconfig
choice
	prompt "Processor Type"
	default KERNEL_IMX31
	depends PACKAGE_LINUX
	help
		The type of Freescale to build the kernel for.

	config KERNEL_IMX31
		bool "i.MX31"

endchoice
config DEFAULT_PACKAGE_BSP
	string
	default "i.MX31"  if KERNEL_IMX31
	depends PACKAGE_LINUX

config ZIMAGE_CONFIG_FILE
	string "Custom kernel configuration file to use?"
	default ""
	depends PACKAGE_LINUX

	help
		Some people may wish to use their own modified kernel configuration
		file, and will specify their config file location with this option.

		Most people will just use the default configuration file.

config TARGET_ZIMAGE_COPYTO
	string "Also copy the zImage to..."
	default ""
	depends PACKAGE_LINUX
	help
		Copies the resulting zImage to a secondary location
		like a tftp server's root directory.
```

## rootfs/packages/libiconv/Config.in
```kconfig
config PACKAGE_LIBICONV
	bool "libiconv"
	default y
	help
	  Support multiple character encodings, but that support lacks from your system.
	
	  http://www.gnu.org/software/libiconv/
```

## rootfs/packages/libusb/Config.in
```kconfig
config PACKAGE_LIBUSB
	bool "Lib USB"
	default y
	help
	  Standard USB userspace library.
```

## rootfs/packages/onyx/Config.in
```kconfig
config PACKAGE_ONYX
	bool "Onyx libraries and applications"
	default y
	help
 	 	 

config PACKAGE_ONYX_LIB
	depends PACKAGE_ONYX
        bool "Onyx libraries"
        default y
        help
          The Onyx SDK libraries.


config PACKAGE_ONYX_APP
	depends PACKAGE_ONYX && PACKAGE_ONYX_LIB
	bool "Onyx Applications"
        default y
        help
          The Onyx applications for the Boox 60.
```

## rootfs/packages/openssl/Config.in
```kconfig
config PACKAGE_OPENSSL
	bool "OpenSSL Toolkit and Libs" 
	default y
	help
		The OpenSSL is a collaborative effort to develop a robust,
		commercial-grade, full-featured toolkit implementing the Secure
		Sockets Layer (SSL v2/v3) and Transport Layer Security (TLS v1)
		protocols as well as a full-strength general purpose cryptography
		library.
```

## rootfs/packages/qt/Config.in
```kconfig
config PACKAGE_QT
	bool "Qt-Embedded Library"
        default y
        help
          Qt provides application developers with all the functionality
          needed to build complex, high-performance GUI and console applications.
```

## rootfs/packages/rootfs/yaffs2/Config.in
```kconfig
config TARGET_ROOTFS_YAFFS2
	bool "yaffs2 root filesystem for the target device"
	default y
	help
	  Build a yaffs2 root filesystem

config TARGET_ROOTFS_YAFFS2_COPYTO
	string "also copy the image to..."
	depends on 	TARGET_ROOTFS_YAFFS2
	default ""
	help
		Copies the resulting image to a secondary location.

config TARGET_ROOTFS_YAFFS2_BOOX_UPDATE
	bool "create a Boox update package"
	depends on 	TARGET_ROOTFS_YAFFS2
	default y
	help
		Creates a Boox 60 update package.

config TARGET_ROOTFS_YAFFS2_BOOX_UPDATE_KERNEL
	bool "include linux kernel"
	depends on 	TARGET_ROOTFS_YAFFS2_BOOX_UPDATE
	default y
	help
		Include the Linux kernel in the update package.

config PACKAGE_UNYAFFS
	bool "build unyaffs tool for host system"
	depends on 	TARGET_ROOTFS_YAFFS2
	default n
	help
		Unyaffs can be used to extract the files and folders
		from a yaffs2 image.
```

## rootfs/packages/sqlite/Config.in
```kconfig
config PACKAGE_SQLITE
        bool "SQLite database engine"
        default y
        help
          SQLite is a software library that implements a self-contained,
          serverless, zero-configuration, transactional SQL database engine.
```

## rootfs/packages/tslib/Config.in
```kconfig
config PACKAGE_TSLIB
        bool "TouchScreen support library"
        default y
        help
          the tslib libiary provides the united user interfaces to operate TS.
          Such as methods for filitering,against dithering and calibrating ...
```

## rootfs/packages/udev/Config.in
```kconfig
config PACKAGE_UDEV
        bool "Udev device manager"
        default y
        help
          Udev provides a dynamic /dev directory, and hooks userspace into
          kernel device events.
```

## rootfs/packages/usb_modeswitch/Config.in
```kconfig
config PACKAGE_USB_MODESWITCH
	depends PACKAGE_LIBUSB
	bool "USB Mode Switch"
	default y
	help
		USB_ModeSwitch is (surprise!) a small mode switching tool
		for controlling "flip flop" (multiple device) USB gear.
```

## rootfs/packages/usbutils/Config.in
```kconfig
config PACKAGE_USBUTILS
	depends PACKAGE_LIBUSB
	bool "USB Utils"
	default y
	help
		Utilities for handling USB devices in userspace.
```

## rootfs/packages/wireless_tools/Config.in
```kconfig
config	PACKAGE_WIRELESS_TOOLS
	bool "Linux wireless tool set"
	default y
	help
		The Wireless Tools (WT) is a set of tools allowing to manipulate the
		Wireless Extensions. They use a textual interface and are rather crude,
		but aim to support the full Wireless Extension.
```

## rootfs/packages/wpa_supplicant/Config.in
```kconfig
config PACKAGE_WPA_SUPPLICANT
	bool"WPA Supplicant for Linux"
	default y
	help
		WPA Supplicant is the IEEE 802.1X/WPA component that is used in the
		client stations. It implements key negotiation with a WPA
		Authenticator and it controls the roaming and IEEE 802.11
		authentication/association of the wlan driver.
```
